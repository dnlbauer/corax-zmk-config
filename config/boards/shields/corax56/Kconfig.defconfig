## config/boards/shields/corax56/Kconfig.defconfig
```kconfig
if SHIELD_CORAX_LEFT

config ZMK_KEYBOARD_NAME
    default "Corax"

config ZMK_SPLIT_ROLE_CENTRAL
    default y
endif

if SHIELD_CORAX_LEFT || SHIELD_CORAX_RIGHT

config ZMK_SPLIT
    default y

endif
```

## config/boards/shields/corax56/Kconfig.shield
```kconfig
config SHIELD_CORAX_LEFT
    def_bool $(shields_list_contains,corax_left)

config SHIELD_CORAX_RIGHT
    def_bool $(shields_list_contains,corax_right)
```
